## mtk/mt7663e/config.in
```kconfig
if PACKAGE_kmod-mt7663e

config MTK_MT7663E_SUPPORT_OPENWRT
	bool
	default y
	depends on PACKAGE_kmod-mt7663e
				
config MTK_MT7663E_WIFI_DRIVER
	bool
	default y
	depends on PACKAGE_kmod-mt7663e
	select MTK_MT7663E_WIFI_MT_MAC
	select MTK_MT7663E_MT_MAC
	select MTK_MT7663E_FIRST_IF_MT7603E

if MTK_MT7663E_WIFI_DRIVER

	choice
		prompt "Choose First WiFi Interface"
		default MTK_MT7663E_FIRST_IF_MT7603E

		config MTK_MT7663E_FIRST_IF_NONE
		bool "None"

		config MTK_MT7663E_FIRST_IF_MT7603E
		bool "MT7603E"
		select MTK_MT7663E_WIFI_MT_MAC
		select MTK_MT7663E_MT_MAC
		select MTK_MT7663E_CHIP_MT7603E

		config MTK_MT7663E_FIRST_IF_MT7615E
		bool "MT7615E"
		select MTK_MT7663E_WIFI_MT_MAC
		select MTK_MT7663E_MT_MAC
		select MTK_MT7663E_CHIP_MT7615E

		config MTK_MT7663E_FIRST_IF_MT7622
		bool "MT7622"
		select MTK_MT7663E_WIFI_MT_MAC
		select MTK_MT7663E_MT_MAC
		select MTK_MT7663E_CHIP_MT7622

		endchoice

	choice
		prompt "Choose Second WiFi Interface"
		default MTK_MT7663E_SECOND_IF_MT7663E

		config MTK_MT7663E_SECOND_IF_NONE
			bool "None"

		config MTK_MT7663E_SECOND_IF_MT7663E
			bool "MT7663E"
			select MTK_MT7663E_WIFI_MT_MAC
			select MTK_MT7663E_CHIP_MT7663E
			select MTK_MT7663E_MULTI_INF_SUPPORT

		config MTK_MT7663E_SECOND_IF_MT7615E
			bool "MT7615E"
			select MTK_MT7663E_WIFI_MT_MAC
			select MTK_MT7663E_CHIP_MT7615E
			select MTK_MT7663E_MULTI_INF_SUPPORT

		endchoice

	choice
		prompt "Choose Third WiFi Interface"
		config MTK_MT7663E_THIRD_IF_NONE
		bool "None"

		config MTK_MT7663E_THIRD_IF_MT7615E
			bool "MT7615E"
			select MTK_MT7663E_WIFI_MT_MAC
			select MTK_MT7663E_CHIP_MT7615E
			select MTK_MT7663E_MULTI_INF_SUPPORT

		endchoice

	config MTK_MT7663E_RT_FIRST_CARD
			int
			depends on ! MTK_MT7663E_FIRST_IF_NONE
			default 7615 if MTK_MT7663E_FIRST_IF_MT7615E
			default 7622 if MTK_MT7663E_FIRST_IF_MT7622
			default 7603 if MTK_MT7663E_FIRST_IF_MT7603E

	config MTK_MT7663E_RT_SECOND_CARD
			int
			depends on ! MTK_MT7663E_SECOND_IF_NONE
			default 7615 if MTK_MT7663E_SECOND_IF_MT7615E
			default 7663 if MTK_MT7663E_SECOND_IF_MT7663E

	config MTK_MT7663E_RT_THIRD_CARD
			int
			depends on ! MTK_MT7663E_THIRD_IF_NONE
			default 7615 if MTK_MT7663E_THIRD_IF_MT7615E

	config MTK_MT7663E_RT_FIRST_IF_RF_OFFSET
			hex
			depends on ! MTK_MT7663E_FIRST_IF_NONE
			default 0x0

	config MTK_MT7663E_RT_SECOND_IF_RF_OFFSET
			hex
			depends on ! MTK_MT7663E_SECOND_IF_NONE
			default 0x8000

	config MTK_MT7663E_RT_THIRD_IF_RF_OFFSET
			hex
			depends on ! MTK_MT7663E_THIRD_IF_NONE
			default 0xd0000

	config MTK_MT7663E_MT_WIFI
		tristate "MT WIFI Driver"
		select MTK_MT7663E_WIFI_BASIC_FUNC if MTK_MT7663E_MT_WIFI
		default y

	config MTK_MT7663E_MT_WIFI_PATH
			string
			depends on MTK_MT7663E_MT_WIFI
			default "mt_wifi"

	if MTK_MT7663E_MT_WIFI
		menu "WiFi Generic Feature Options"
		choice
			prompt "EEPROM Type of 1st Card"
			depends on ! MTK_MT7663E_FIRST_IF_NONE

			config MTK_MT7663E_FIRST_IF_EEPROM_FLASH
			bool "FLASH"

			config MTK_MT7663E_FIRST_IF_EEPROM_EFUSE
			bool "EFUSE"
		
			endchoice

		config MTK_MT7663E_RT_FIRST_CARD_EEPROM
			string
			depends on ! MTK_MT7663E_FIRST_IF_NONE
			default "flash" if MTK_MT7663E_FIRST_IF_EEPROM_FLASH

		choice
			prompt "EEPROM Type of 2nd Card"
			depends on ! MTK_MT7663E_SECOND_IF_NONE

			config MTK_MT7663E_SECOND_IF_EEPROM_FLASH
			bool "FLASH"

			config MTK_MT7663E_SECOND_IF_EEPROM_PROM
			bool "EEPROM"

			config MTK_MT7663E_SECOND_IF_EEPROM_EFUSE
			bool "EFUSE"

			endchoice

		config MTK_MT7663E_RT_SECOND_CARD_EEPROM
			string
			depends on ! MTK_MT7663E_SECOND_IF_NONE
			default "prom" if MTK_MT7663E_SECOND_IF_EEPROM_PROM
			default "efuse" if MTK_MT7663E_SECOND_IF_EEPROM_EFUSE
			default "flash" if MTK_MT7663E_SECOND_IF_EEPROM_FLASH

		choice
			prompt "EEPROM Type of 3th Card"
			depends on ! MTK_MT7663E_THIRD_IF_NONE

			config MTK_MT7663E_THIRD_IF_EEPROM_FLASH
			bool "FLASH"

			config MTK_MT7663E_THIRD_IF_EEPROM_PROM
			bool "EEPROM"

			config MTK_MT7663E_THIRD_IF_EEPROM_EFUSE
			bool "EFUSE"

		endchoice

		config MTK_MT7663E_RT_THIRD_CARD_EEPROM
			string
			depends on ! MTK_MT7663E_THIRD_IF_NONE
			default "prom" if MTK_MT7663E_THIRD_IF_EEPROM_PROM
			default "efuse" if MTK_MT7663E_THIRD_IF_EEPROM_EFUSE
			default "flash" if MTK_MT7663E_THIRD_IF_EEPROM_FLASH
	
		config MTK_MT7663E_MULTI_INF_SUPPORT
			bool
			default y if !MTK_MT7663E_FIRST_IF_NONE && !MTK_MT7663E_SECOND_IF_NONE

		config MTK_MT7663E_MT76XX_COMBO_DUAL_DRIVER_SUPPORT
			bool "MT76XX Combo Dual Driver support"
			depends on MTK_MT7663E_CHIP_MT7615E && MTK_MT7663E_CHIP_MT7663E
			default n

		config MTK_MT7663E_WIFI_BASIC_FUNC
			bool "Basic Functions"
			select MTK_MT7663E_WIRELESS_EXT
			select MTK_MT7663E_WEXT_SPY
			select MTK_MT7663E_WEXT_PRIV

		config MTK_MT7663E_DOT11_N_SUPPORT
			bool "802.11n support"
			default y

		config MTK_MT7663E_DOT11_VHT_AC
			bool "802.11AC support"
			depends on MTK_MT7663E_WIFI_DRIVER
			depends on MTK_MT7663E_DOT11_N_SUPPORT
			default y

		config MTK_MT7663E_G_BAND_256QAM_SUPPORT
			bool "2.4G 256QAM support"
			depends on MTK_MT7663E_WIFI_DRIVER
			depends on MTK_MT7663E_DOT11_VHT_AC
			default y

		config MTK_MT7663E_TPC_SUPPORT
			bool "802.11h TPC Support"
			depends on MTK_MT7663E_WIFI_DRIVER
			default y

		config MTK_MT7663E_THERMAL_PROTECT_SUPPORT
			bool "Thermal Portect Support"
			depends on MTK_MT7663E_WIFI_DRIVER
			default n

		config MTK_MT7663E_ICAP_SUPPORT
			bool "ICAP Support"
			depends on MTK_MT7663E_WIFI_DRIVER
			depends on MTK_MT7663E_MT_AP_SUPPORT
			default y

		config MTK_MT7663E_SPECTRUM_SUPPORT
			bool "Wifi Spectrum Support"
			depends on MTK_MT7663E_WIFI_DRIVER
			depends on MTK_MT7663E_MT_AP_SUPPORT
			default y

		config MTK_MT7663E_BACKGROUND_SCAN_SUPPORT
			bool "Background Scan Support"
			depends on MTK_MT7663E_WIFI_DRIVER
			default y
			
		config MTK_MT7663E_SMART_CARRIER_SENSE_SUPPORT
			bool "Smart Carrier Sense Support"
			depends on MTK_MT7663E_WIFI_DRIVER
			default y

		config MTK_MT7663E_SCS_FW_OFFLOAD
				bool "Smart Carrier Sense Offload Support"
				depends on MTK_MT7663E_WIFI_DRIVER && MTK_MT7663E_SMART_CARRIER_SENSE_SUPPORT
				default n
			
		config MTK_MT7663E_MT_DFS_SUPPORT
				bool "Dynamic Frequency Selection Support"	
				depends on MTK_MT7663E_WIFI_DRIVER
				default y
		config MTK_MT7663E_OFFCHANNEL_SCAN_FEATURE
			bool "Channel Quality Monitor"
			depends on MTK_MT7663E_WIFI_DRIVER
			depends on MTK_MT7663E_MT_AP_SUPPORT
			default n
		#config MTK_MT7663E_WFA_VHT_R2_PF
		#    bool "WFA VHT R2 Plugfest"
		#    depends on MTK_MT7663E_DOT11_VHT_AC
		#    default n

		config MTK_MT7663E_HDR_TRANS_TX_SUPPORT
			bool "Tx Header Translation"
			depends on (MTK_MT7663E_CHIP_MT7615E && !MTK_MT7663E_MT76XX_COMBO_DUAL_DRIVER_SUPPORT) || MTK_MT7663E_CHIP_MT7622 || MTK_MT7663E_CHIP_MT7663E || MTK_MT7663E_CHIP_MT7626
			default y

		config MTK_MT7663E_HDR_TRANS_RX_SUPPORT
			bool "Rx Header Translation"
			depends on (MTK_MT7663E_CHIP_MT7615E && !MTK_MT7663E_MT76XX_COMBO_DUAL_DRIVER_SUPPORT) || MTK_MT7663E_CHIP_MT7622 || MTK_MT7663E_CHIP_MT7663E || MTK_MT7663E_CHIP_MT7626
			default y

		config MTK_MT7663E_DBDC_MODE
			bool "dbdc mode support"
			depends on (MTK_MT7663E_CHIP_MT7615E && !MTK_MT7663E_MT76XX_COMBO_DUAL_DRIVER_SUPPORT) || MTK_MT7663E_CHIP_MT7626
			select MTK_MT7663E_MULTI_PROFILE_SUPPORT
			#select MTK_MT7663E_DEFAULT_5G_PROFILE
			default y

		config MTK_MT7663E_MULTI_PROFILE_SUPPORT
			bool "Multi Profile Support"
			depends on MTK_MT7663E_DBDC_MODE
			default y

		config MTK_MT7663E_DEFAULT_5G_PROFILE
			bool "5G default profile for DBDC"
			depends on MTK_MT7663E_CHIP_MT7615E && !MTK_MT7663E_MT76XX_COMBO_DUAL_DRIVER_SUPPORT
			depends on MTK_MT7663E_DBDC_MODE
			default y

		config MTK_MT7663E_WSC_INCLUDED
			bool "WSC (WiFi Simple Config)"
			depends on MTK_MT7663E_WIFI_DRIVER
			depends on MTK_MT7663E_MT_AP_SUPPORT || MTK_MT7663E_MT_STA_SUPPORT
			default y

		config MTK_MT7663E_WSC_V2_SUPPORT
			bool "WSC V2(WiFi Simple config MTK_MT7663E_Version MTK_MT7663E_2.0)"
			depends on MTK_MT7663E_WIFI_DRIVER
			depends on MTK_MT7663E_MT_AP_SUPPORT || MTK_MT7663E_MT_STA_SUPPORT
			default y

		config MTK_MT7663E_DOT11W_PMF_SUPPORT
			bool "PMF"
			depends on MTK_MT7663E_WIFI_DRIVER
			depends on MTK_MT7663E_MT_AP_SUPPORT || MTK_MT7663E_MT_STA_SUPPORT
			default y

		config MTK_MT7663E_TXBF_SUPPORT
				bool "Tx Bean Forming Support"
				depends on MTK_MT7663E_WIFI_DRIVER
				default y

		config MTK_MT7663E_FAST_NAT_SUPPORT
			bool "Fast-NAT support"
			depends on MTK_MT7663E_RA_HW_NAT_WIFI
			default n

		config MTK_MT7663E_WHNAT_SUPPORT
			tristate "Wifi Hardware NAT support"
			depends on MTK_MT7663E_CHIP_MT7615E && !MTK_MT7663E_MT76XX_COMBO_DUAL_DRIVER_SUPPORT
			depends on MTK_MT7663E_WLAN_HOOK
			depends on MTK_MT7663E_FAST_NAT_SUPPORT
			select PACKAGE_kmod-hw_nat
			default n

		#config MTK_MT7663E_LLTD_SUPPORT
		#	bool "LLTD (Link Layer Topology Discovery Protocol)"
		#	depends on MTK_MT7663E_WIFI_DRIVER
		#	depends on MTK_MT7663E_MT_AP_SUPPORT
		#	default n

		#config MTK_MT7663E_QOS_DLS_SUPPORT
		#	bool "802.11e DLS ((Direct-Link Setup) Support"
		#	depends on MTK_MT7663E_WIFI_DRIVER
		#	depends on MTK_MT7663E_MT_AP_SUPPORT
		#	default n

		#config MTK_MT7663E_WAPI_SUPPORT
		#	bool "WAPI Support"
		#	depends on MTK_MT7663E_WIFI_DRIVER
		#	default n

		config MTK_MT7663E_FTM_SUPPORT
			bool "FTM Support"
			depends on MTK_MT7663E_WIFI_DRIVER
			select MTK_MT7663E_PASSPOINT_R2
			default n

		config MTK_MT7663E_MBO_SUPPORT
			bool "MBO Support"
			depends on MTK_MT7663E_WIFI_DRIVER
			select MTK_MT7663E_INTERWORKING
			select MTK_MT7663E_WNM_SUPPORT
			select MTK_MT7663E_DOT11K_RRM_SUPPORT
			select MTK_MT7663E_DOT11R_FT_SUPPORT
			select MTK_MT7663E_DOT11W_PMF_SUPPORT
			select MTK_MT7663E_WAPP_SUPPORT
			default n

		#config MTK_MT7663E_CARRIER_DETECTION_SUPPORT
		#	bool "Carrier Detect"
		#	depends on MTK_MT7663E_WIFI_DRIVER
		#	default n

		config MTK_MT7663E_IGMP_SNOOP_SUPPORT
			bool "IGMP snooping"
			depends on MTK_MT7663E_WIFI_DRIVER
			depends on MTK_MT7663E_MT_AP_SUPPORT
			default y

		config MTK_MT7663E_MEMORY_SHRINK
			bool "Memory Shrink"
			depends on MTK_MT7663E_WIFI_DRIVER && MTK_MT7663E_CHIP_MT7626
			default n

		#config MTK_MT7663E_BLOCK_NET_IF
		#	bool "NETif MTK_MT7663E_Block"
		#	depends on MTK_MT7663E_WIFI_DRIVER
		#	depends on MTK_MT7663E_MT_AP_SUPPORT
		#	default n
		#	help
		#	Support Net interface block while Tx-Sw queue full

		#config MTK_MT7663E_RATE_ADAPTION
		#	bool "New Rate Adaptation MTK_MT7663E_support"
		#	depends on MTK_MT7663E_WIFI_DRIVER
		#	default y

		#config MTK_MT7663E_NEW_RATE_ADAPT_SUPPORT
		#	bool "Intelligent Rate Adaption"
		#	depends on MTK_MT7663E_WIFI_DRIVER && MTK_MT7663E_RATE_ADAPTION
		#	default y

		#config MTK_MT7663E_AGS_SUPPORT
		#	bool "Adaptive Group Switching"
		#	depends on MTK_MT7663E_WIFI_DRIVER && MTK_MT7663E_RATE_ADAPTION
		#	depends on MTK_MT7663E_MT_AP_SUPPORT || MTK_MT7663E_MT_STA_SUPPORT
		#	default n

		#config MTK_MT7663E_RATE_ADAPT_AGBS_SUPPORT
		#	bool "Adaptive AGBS Mode"
		#	depends on MTK_MT7663E_WIFI_DRIVER && MTK_MT7663E_RATE_ADAPTION
		#	depends on MTK_MT7663E_MT_AP_SUPPORT || MTK_MT7663E_MT_STA_SUPPORT
		#	default y

		#config MTK_MT7663E_IDS_SUPPORT
		#	bool "IDS (Intrusion Detection System) Support"
		#	depends on MTK_MT7663E_WIFI_DRIVER
		#	depends on MTK_MT7663E_MT_AP_SUPPORT
		#	default n

		#config MTK_MT7663E_WIFI_WORK_QUEUE
		#	bool "Work Queue"
		#	depends on MTK_MT7663E_WIFI_DRIVER
		#	default n

		#config MTK_MT7663E_WIFI_SKB_RECYCLE
		#	bool "SKB Recycle(Linux)"
		#	depends on MTK_MT7663E_WIFI_DRIVER
		#	depends on MTK_MT7663E_MT_AP_SUPPORT
		#	default n

		config MTK_MT7663E_RTMP_FLASH_SUPPORT
			bool "Flash Support"
			depends on MTK_MT7663E_WIFI_DRIVER
			default y

		config MTK_MT7663E_PRE_CAL_TRX_SET1_SUPPORT
			bool "Calibration To Flash/BinFile Support"
			depends on MTK_MT7663E_WIFI_DRIVER
			depends on MTK_MT7663E_CHIP_MT7615E && !MTK_MT7663E_MT76XX_COMBO_DUAL_DRIVER_SUPPORT
			default y

		config MTK_MT7663E_RLM_CAL_CACHE_SUPPORT
			bool "RlmCalibrationCache Support"
			depends on MTK_MT7663E_WIFI_DRIVER
			depends on MTK_MT7663E_CHIP_MT7615E && !MTK_MT7663E_MT76XX_COMBO_DUAL_DRIVER_SUPPORT
			default y

		config MTK_MT7663E_PRE_CAL_TRX_SET2_SUPPORT
			bool "Pre-calibration to Flash Support"
			depends on MTK_MT7663E_WIFI_DRIVER
			depends on MTK_MT7663E_CHIP_MT7615E && !MTK_MT7663E_MT76XX_COMBO_DUAL_DRIVER_SUPPORT
			default y

		config MTK_MT7663E_CAL_BIN_FILE_SUPPORT
			bool "Calibration to BinFile Support"
			depends on MTK_MT7663E_WIFI_DRIVER
			default y

		config MTK_MT7663E_RF_LOCKDOWN_SUPPORT
			bool "RF Lockdown Support"
			depends on MTK_MT7663E_WIFI_DRIVER
			depends on MTK_MT7663E_CHIP_MT7615E && !MTK_MT7663E_MT76XX_COMBO_DUAL_DRIVER_SUPPORT
			default n	

		config MTK_MT7663E_LINK_TEST_SUPPORT
			bool "Link Test Support"
			depends on MTK_MT7663E_WIFI_DRIVER
			default y

		config MTK_MT7663E_WIFI_GPIO_CTRL
			bool "GPIO Control Support"
			depends on MTK_MT7663E_WIFI_DRIVER
			default y

		config MTK_MT7663E_MIN_PHY_RATE_SUPPORT
			bool "Min-PHY Rate Support"
			depends on MTK_MT7663E_WIFI_DRIVER
			default n

		#config MTK_MT7663E_LED_CONTROL_SUPPORT
		#	bool "LED Support"
		#	depends on MTK_MT7663E_WIFI_DRIVER
		#	depends on MTK_MT7663E_MT_AP_SUPPORT
		#	default n

		config MTK_MT7663E_VENDOR_FEATURE11_SUPPORT
			bool "Vendor11 Feature Enable"
			depends on MTK_MT7663E_WIFI_DRIVER
			depends on MTK_MT7663E_MT_AP_SUPPORT
			default n

		config MTK_MT7663E_ATE_SUPPORT
			bool "ATE/QA Support"
			depends on MTK_MT7663E_WIFI_DRIVER
			default y

		config MTK_MT7663E_MEMORY_OPTIMIZATION
			bool "Memory Optimization"
			depends on MTK_MT7663E_WIFI_DRIVER
			default n

		config MTK_MT7663E_PASSPOINT_R2
			bool "Passpoint Release-2 Support"
			depends on MTK_MT7663E_WIFI_DRIVER
			select MTK_MT7663E_DOT11W_PMF_SUPPORT
			select MTK_MT7663E_WAPP_SUPPORT
			depends on MTK_MT7663E_MT_AP_SUPPORT
			default n

		#config MTK_MT7663E_TRACE_TCP_PKT
		#       bool "TCP DATA/ACK packets trace log"
		#       depends on MTK_MT7663E_WIFI_DRIVER
		#       default n

		config MTK_MT7663E_UAPSD
			bool "UAPSD support"
			depends on MTK_MT7663E_WIFI_DRIVER
			depends on MTK_MT7663E_MT_AP_SUPPORT || MTK_MT7663E_MT_STA_SUPPORT
			default y

		config MTK_MT7663E_TCP_RACK_SUPPORT
			bool "TCP Reduced ACK  support"
			depends on MTK_MT7663E_WIFI_DRIVER
			default n

		#### PA_LNA_Type choice

		config MTK_MT7663E_RED_SUPPORT
				bool "RED(Random Early Drop) support"
			depends on MTK_MT7663E_WIFI_DRIVER
			depends on MTK_MT7663E_MT_AP_SUPPORT || MTK_MT7663E_MT_STA_SUPPORT
				default y

		config MTK_MT7663E_FDB_SUPPORT
			bool "FW Debug Port"
			depends on MTK_MT7663E_WIFI_DRIVER
			default n

		choice
				prompt "PA LNA Type of 1st Card"
				depends on ! MTK_MT7663E_FIRST_IF_NONE
				default MTK_MT7663E_FIRST_IF_IPAILNA
				
				config MTK_MT7663E_FIRST_IF_EPAELNA
				bool "ePAeLNA"
				config MTK_MT7663E_FIRST_IF_IPAILNA
				bool "iPAiLNA"		
				config MTK_MT7663E_FIRST_IF_IPAELNA
				bool "iPAeLNA"
		#		config MTK_MT7663E_FIRST_IF_EPAILNA
		#		bool "ePAiLNA"
		endchoice
		choice
				prompt "PA LNA Type of 2nd Card"
				depends on ! MTK_MT7663E_SECOND_IF_NONE
				default MTK_MT7663E_SECOND_IF_IPAILNA

				config MTK_MT7663E_SECOND_IF_EPAELNA
				bool "ePAeLNA"
				config MTK_MT7663E_SECOND_IF_IPAILNA
				bool "iPAiLNA"		
				config MTK_MT7663E_SECOND_IF_IPAELNA
				bool "iPAeLNA"
		#		config MTK_MT7663E_SECOND_IF_EPAILNA
		#		bool "ePAiLNA"
		endchoice
		choice
				prompt "PA LNA Type of 3rd Card"
				depends on ! MTK_MT7663E_THIRD_IF_NONE
				default MTK_MT7663E_THIRD_IF_IPAILNA

				config MTK_MT7663E_THIRD_IF_EPAELNA
				bool "ePAeLNA"
				config MTK_MT7663E_THIRD_IF_IPAILNA
				bool "iPAiLNA"		
				config MTK_MT7663E_THIRD_IF_IPAELNA
				bool "iPAeLNA"
		#		config MTK_MT7663E_THIRD_IF_EPAILNA
		#		bool "ePAiLNA"
		endchoice
		#### PA_LNA_Type choice END 

		#
		# Section for chip architectures
		#
		# "RLT MAC Support"
		config MTK_MT7663E_RLT_MAC
			bool
			depends on MTK_MT7663E_WIFI_DRIVER
			default n

		config MTK_MT7663E_RLT_BBP
			bool

		config MTK_MT7663E_RLT_RF
			bool

		# "RTMP MAC Support"
		config MTK_MT7663E_RTMP_MAC
			bool
			depends on MTK_MT7663E_WIFI_DRIVER
			default n

		config MTK_MT7663E_RTMP_BBP
				bool

		config MTK_MT7663E_RTMP_RF
				bool

		#
		# Section for interfaces
		#
		config MTK_MT7663E_RTMP_PCI_SUPPORT
				bool

		config MTK_MT7663E_RTMP_USB_SUPPORT
				bool

		config MTK_MT7663E_RTMP_RBUS_SUPPORT
				bool

		endmenu

menu "WiFi Operation Modes"

		config MTK_MT7663E_WIFI_MODE_AP
				tristate "AP"
				default y
				select MTK_MT7663E_MT_AP_SUPPORT

		config MTK_MT7663E_WIFI_MODE_STA
				tristate "STA"
				select MTK_MT7663E_MT_STA_SUPPORT

		config MTK_MT7663E_WIFI_MODE_BOTH
				tristate "APSTA"
				select MTK_MT7663E_MT_AP_SUPPORT
				select MTK_MT7663E_MT_STA_SUPPORT

config MTK_MT7663E_MT_AP_SUPPORT
	tristate "Ralink RT2860 802.11n AP support"
#	depends on MTK_MT7663E_NET_RADIO 
	select MTK_MT7663E_WIRELESS_EXT
	select MTK_MT7663E_WEXT_SPY
	select MTK_MT7663E_WEXT_PRIV

config MTK_MT7663E_WDS_SUPPORT
	bool "WDS"
	depends on MTK_MT7663E_MT_AP_SUPPORT
	default y

config MTK_MT7663E_WIFI_EAP_FEATURE
	bool "EAP Feature"
    depends on MTK_MT7663E_WIFI_DRIVER
	default y

config MTK_MT7663E_VLAN_SUPPORT
	bool "VLAN support"
	depends on MTK_MT7663E_MT_AP_SUPPORT && MTK_MT7663E_WIFI_EAP_FEATURE
	default n

config MTK_MT7663E_SNIFFER_SUPPORT
	bool "SNIFFER"
	depends on MTK_MT7663E_MT_AP_SUPPORT && MTK_MT7663E_WIFI_EAP_FEATURE
	default n

config MTK_MT7663E_TXRX_STAT_SUPPORT
	bool "TxRx Stats Support"
	depends on MTK_MT7663E_WIFI_DRIVER && MTK_MT7663E_WIFI_EAP_FEATURE
	default n

config MTK_MT7663E_ANTENNA_CONTROL_SUPPORT
	bool "Antenna Control"
	depends on MTK_MT7663E_MT_AP_SUPPORT && MTK_MT7663E_WIFI_EAP_FEATURE
	default n

config MTK_MT7663E_MGMT_TXPWR_CTRL
	bool "Mgmt TxPower Control"
	depends on MTK_MT7663E_MT_AP_SUPPORT && MTK_MT7663E_WIFI_EAP_FEATURE
	default n

config MTK_MT7663E_CHUTIL_SUPPORT
	bool "Channel Utilization Support"
	depends on MTK_MT7663E_MT_AP_SUPPORT && MTK_MT7663E_WIFI_EAP_FEATURE
	default n

config MTK_MT7663E_NF_SUPPORT
	bool "Noise Floor Support"
	depends on MTK_MT7663E_MT_AP_SUPPORT && MTK_MT7663E_WIFI_EAP_FEATURE
	default n

config MTK_MT7663E_RA_PHY_RATE_SUPPORT
	bool "RA PHY RATE Support"
	depends on MTK_MT7663E_MT_AP_SUPPORT && MTK_MT7663E_WIFI_EAP_FEATURE
	default n

config MTK_MT7663E_AMPDU_CONF_SUPPORT
	bool "AMPDU config retry & agglimitSupport"
	depends on MTK_MT7663E_MT_AP_SUPPORT && MTK_MT7663E_WIFI_EAP_FEATURE
	default n

config MTK_MT7663E_ACK_CTS_TIMEOUT_SUPPORT
	bool "ACK CTS Timeout cck & ofdm Support"
	depends on MTK_MT7663E_MT_AP_SUPPORT && MTK_MT7663E_WIFI_EAP_FEATURE
	default n

config MTK_MT7663E_WIFI_GPIO_CTRL
	bool "GPIO Control"
    depends on MTK_MT7663E_WIFI_DRIVER
	default y

config MTK_MT7663E_MBSS_SUPPORT
	bool "MBSSID"
	depends on MTK_MT7663E_MT_AP_SUPPORT
	default y

config MTK_MT7663E_MIN_PHY_RATE_SUPPORT
	bool "Min-PHY Rate Support"
	depends on MTK_MT7663E_WIFI_DRIVER
	default n

#config MTK_MT7663E_NEW_MBSSID_MODE
#	bool "New MBSSID MODE"
#	depends on MTK_MT7663E_MT_AP_SUPPORT && MTK_MT7663E_MBSS_SUPPORT
#	depends on MTK_MT7663E_RALINK_RT3883 || MTK_MT7663E_RALINK_RT3352 || MTK_MT7663E_RALINK_RT5350 || MTK_MT7663E_RALINK_RT6352 || MTK_MT7663E_RALINK_MT7620
#	default y

#config MTK_MT7663E_ENHANCE_NEW_MBSSID_MODE
#	bool "Enhanced MBSSID mode"
#	depends on MTK_MT7663E_NEW_MBSSID_MODE
#	default y

config MTK_MT7663E_APCLI_SUPPORT
	bool "AP-Client Support"
	depends on MTK_MT7663E_MT_AP_SUPPORT
	default y

config MTK_MT7663E_APCLI_CERT_SUPPORT
	bool "AP-Client TGn Cert Support"
	depends on MTK_MT7663E_MT_AP_SUPPORT
	depends on MTK_MT7663E_APCLI_SUPPORT
	default n

config MTK_MT7663E_MAC_REPEATER_SUPPORT
	bool "MAC Repeater Support"
	depends on MTK_MT7663E_MT_AP_SUPPORT
	depends on MTK_MT7663E_APCLI_SUPPORT
	depends on MTK_MT7663E_RALINK_RT6352 || MTK_MT7663E_RALINK_MT7620 || MTK_MT7663E_RALINK_MT7603E || MTK_MT7663E_MT_AP_SUPPORT
	default y

config MTK_MT7663E_MWDS
    bool "Mixed WDS(MWDS)"
    depends on MTK_MT7663E_CHIP_MT7615E && !MTK_MT7663E_MT76XX_COMBO_DUAL_DRIVER_SUPPORT
    depends on MTK_MT7663E_MT_AP_SUPPORT
    select MTK_MT7663E_APCLI_SUPPORT
    default n

config MTK_MT7663E_MUMIMO_SUPPORT
	bool "MU-MIMO Support"
	depends on MTK_MT7663E_WIFI_DRIVER
	select MTK_MT7663E_MU_RA_SUPPORT
	default y

config MTK_MT7663E_MU_RA_SUPPORT
  	bool "MU-RGA Support"
  	depends on MTK_MT7663E_MUMIMO_SUPPORT
  	
config MTK_MT7663E_DOT11R_FT_SUPPORT
	bool "802.11r Fast BSS Transition"
	depends on MTK_MT7663E_MT_AP_SUPPORT
	default n

config MTK_MT7663E_DOT11K_RRM_SUPPORT
	bool "802.11k Radio Resource Management"
	depends on MTK_MT7663E_MT_AP_SUPPORT
	default n

config MTK_MT7663E_KVRH_SUPPORT
	bool "Query STA 802.11k/v/r/h Capability"
	depends on MTK_MT7663E_MT_AP_SUPPORT
	default n

config MTK_MT7663E_INTERWORKING
	bool "802.11u Interworking/Gas Support"
        depends on MTK_MT7663E_MT_AP_SUPPORT
        default n

config MTK_MT7663E_MAP_SUPPORT
	bool "Multi-AP Support"
	depends on MTK_MT7663E_MT_AP_SUPPORT
	#select MTK_MT7663E_MBO_SUPPORT
	select MTK_MT7663E_WAPP_SUPPORT
	default n

config MTK_MT7663E_OFFCHANNEL_SCAN_FEATURE
	bool "Channel Quality Monitor"
	depends on MTK_MT7663E_MT_AP_SUPPORT
	default n

config MTK_MT7663E_WAPP_SUPPORT
	bool "WAPP Support"
	depends on MTK_MT7663E_MT_AP_SUPPORT
	select MTK_MT7663E_INTERWORKING
	select MTK_MT7663E_WNM_SUPPORT
	select MTK_MT7663E_DOT11K_RRM_SUPPORT
	select MTK_MT7663E_DOT11R_FT_SUPPORT
	select MTK_MT7663E_DOT11W_PMF_SUPPORT
	default n

config MTK_MT7663E_OCE_SUPPORT
        bool "Optimized Connectivity Experience Support"
        depends on MTK_MT7663E_MT_AP_SUPPORT
	depends on MTK_MT7663E_CHIP_MT7663E
	select MTK_MT7663E_WAPP_SUPPORT
	default n

config MTK_MT7663E_WIFI_MSI_SUPPORT
        bool "MSI support"
        depends on MTK_MT7663E_PCI_MSI
        depends on MTK_MT7663E_CHIP_MT7615E && !MTK_MT7663E_MT76XX_COMBO_DUAL_DRIVER_SUPPORT
        default n

config MTK_MT7663E_CFG80211_SUPPORT
	bool "CFG80211"
	depends on MTK_MT7663E_MT_AP_SUPPORT
	default n

#config MTK_MT7663E_DSCP_PRI_SUPPORT
#	bool "Dscp Priority Mapping Support
#	depends on MTK_MT7663E_MT_AP_SUPPORT
#	default n

config MTK_MT7663E_DSCP_PRI_SUPPORT
	bool "Dscp Priority Mapping Support"
	depends on MTK_MT7663E_MT_AP_SUPPORT
	default n

config MTK_MT7663E_CON_WPS_SUPPORT
	bool "Concurrent WPS Support"
	depends on MTK_MT7663E_MT_AP_SUPPORT
	depends on MTK_MT7663E_APCLI_SUPPORT
	depends on MTK_MT7663E_WSC_INCLUDED
	depends on MTK_MT7663E_WSC_V2_SUPPORT
#	depends on MTK_MT7663E_MULTI_INF_SUPPORT
	default n
	
#config MTK_MT7663E_LLTD_SUPPORT
#	bool "LLTD (Link Layer Topology Discovery Protocol)"
#	depends on MTK_MT7663E_MT_AP_SUPPORT

#config MTK_MT7663E_COC_SUPPORT
#	bool "CoC Support"
#	depends on MTK_MT7663E_MT_AP_SUPPORT
#	default n

#config MTK_MT7663E_RT2860V2_SNMP
#	bool "Net-SNMP Support"
#	depends on MTK_MT7663E_MT_AP_SUPPORT

config MTK_MT7663E_MCAST_RATE_SPECIFIC
	bool "User specific tx rate of mcast pkt"
	depends on MTK_MT7663E_MT_AP_SUPPORT
	default y

#config MTK_MT7663E_EXT_BUILD_CHANNEL_LIST
#	bool "Extension MTK_MT7663E_Channel List"
#	depends on MTK_MT7663E_MT_AP_SUPPORT

#config MTK_MT7663E_AUTO_CH_SELECT_ENHANCE
#	bool "Auto Channel Selection MTK_MT7663E_Enhancement"
#	depends on MTK_MT7663E_MT_AP_SUPPORT

config MTK_MT7663E_VOW_SUPPORT
	bool "MediaAir(VOW) support"
	depends on MTK_MT7663E_MT_AP_SUPPORT
	default y

#config MTK_MT7663E_AIRPLAY_SUPPORT
#	bool "AIRPLAY Support"
#	depends on MTK_MT7663E_MT_AP_SUPPORT
#	default n

config MTK_MT7663E_CUSTOMER_RSG_FEATURE
        bool "Customer RSG feature"
        depends on MTK_MT7663E_MT_AP_SUPPORT
        default n

config MTK_MT7663E_CUSTOMER_DCC_FEATURE
        bool "Customer DCC feature"
        depends on MTK_MT7663E_MT_AP_SUPPORT
        default n

config MTK_MT7663E_BAND_STEERING
	bool "Band Steering"
	depends on MTK_MT7663E_MT_AP_SUPPORT
	default y

config MTK_MT7663E_LED_CONTROL_SUPPORT
	bool "LED Control Support"
	default n

config MTK_MT7663E_WLAN_HOOK
	bool "WLAN hook Support"
	depends on MTK_MT7663E_WIFI_DRIVER
	default n

config MTK_MT7663E_RADIUS_ACCOUNTING_SUPPORT
	bool "Radius Accounting Support"
	depends on MTK_MT7663E_MT_AP_SUPPORT
	default n

config MTK_MT7663E_GREENAP_SUPPORT
	bool "GreenAP Support"
	depends on MTK_MT7663E_MT_AP_SUPPORT
	default y

config MTK_MT7663E_PCIE_ASPM_DYM_CTRL_SUPPORT
	bool "Pcie Aspm Dynamic Control Support"
	depends on MTK_MT7663E_MT_AP_SUPPORT
	default y

config MTK_MT7663E_COEX_SUPPORT
	bool "Coex Support"
	depends on MTK_MT7663E_MT_AP_SUPPORT
	default n

config MTK_MT7663E_EASY_SETUP_SUPPORT
	bool "Whole Home Coverage - Easy Setup"
	depends on MTK_MT7663E_MT_AP_SUPPORT
	depends on MTK_MT7663E_CHIP_MT7615E && !MTK_MT7663E_MT76XX_COMBO_DUAL_DRIVER_SUPPORT
	default n    

config MTK_MT7663E_EVENT_NOTIFIER_SUPPORT
	bool "Whole Home Coverage - Event Notifier"
	depends on MTK_MT7663E_MT_AP_SUPPORT
	depends on MTK_MT7663E_CHIP_MT7615E && !MTK_MT7663E_MT76XX_COMBO_DUAL_DRIVER_SUPPORT
	default n

config MTK_MT7663E_AIR_MONITOR
	bool "Air Monitor"
	depends on MTK_MT7663E_MT_AP_SUPPORT
	default n

config MTK_MT7663E_WNM_SUPPORT
	bool "802.11v WNM Support"
	depends on MTK_MT7663E_MT_AP_SUPPORT
	default n

config MTK_MT7663E_CUSTOMER_VENDOR_IE_SUPPORT
	bool "Customer Vendor IE support"
	depends on MTK_MT7663E_MT_AP_SUPPORT
	depends on MTK_MT7663E_CHIP_MT7663E
	default n

#config MTK_MT7663E_ROAMING_ENHANCE_SUPPORT
#	bool "Roaming Enhance Support"
#	depends on MTK_MT7663E_MT_AP_SUPPORT
#	depends on MTK_MT7663E_APCLI_SUPPORT
#	default n

#config MTK_MT7663E_WIFI_FWD_SUPPORT
#        bool "WiFi Forwarding Support"
#        default n

config MTK_MT7663E_WPA3_SUPPORT
	bool "WPA3 support"
	depends on MTK_MT7663E_MT_AP_SUPPORT
	default y

config MTK_MT7663E_OWE_SUPPORT
	bool "Enhance OPEN(OWE) support"
	depends on MTK_MT7663E_MT_AP_SUPPORT
	depends on MTK_MT7663E_WPA3_SUPPORT
	default y

config MTK_MT7663E_APCLI_CONNECTION_TRIAL
        bool "Trial Connection"
        depends on MTK_MT7663E_MT_AP_SUPPORT
        depends on MTK_MT7663E_APCLI_SUPPORT
        default n

config MTK_MT7663E_VENDOR_FEATURE11_SUPPORT
	bool "Vendor11 Feature Enable"
	depends on MTK_MT7663E_WIFI_DRIVER
	depends on MTK_MT7663E_MT_AP_SUPPORT
	default n
config MTK_MT7663E_IXIA_SUPPORT
	bool "IXIA Test Configure"
	depends on MTK_MT7663E_WIFI_DRIVER
	depends on MTK_MT7663E_MT_AP_SUPPORT
	default n

endmenu	

endif

if MTK_MT7663E_WIFI_RLT_MAC
	config MTK_MT7663E_RLT_MAC
		bool
		default y
endif

if MTK_MT7663E_WIFI_RTMP_MAC
	config MTK_MT7663E_RTMP_MAC
		bool
		default y
endif

config MTK_MT7663E_WIFI_MT_MAC
	bool
	default y
	depends on MTK_MT7663E_WIFI_DRIVER

if MTK_MT7663E_WIFI_MT_MAC
	config MTK_MT7663E_MT_MAC
		bool
		default y
endif

if MTK_MT7663E_WIFI_MT_MAC
	config MTK_MT7663E_TEST
		bool
		default y

	config MTK_MT7663E_CHIP_MT7603E
		bool
		default n

	config MTK_MT7663E_CHIP_MT7615E
		bool
		default n

	config MTK_MT7663E_CHIP_MT7622
		bool
		default n

	config MTK_MT7663E_CHIP_MT7663E
		bool
		default n

	config MTK_MT7663E_CHIP_MT7626
		bool
		default n
endif

if (! MTK_MT7663E_MT76XX_COMBO_DUAL_DRIVER_SUPPORT)
if MTK_MT7663E_CHIP_MT7663E
	config MTK_MT7663E_MT_MAC
		bool
		default y
		select MTK_MT7663E_RATE_ADAPTION
		select MTK_MT7663E_RATE_ADAPT_AGBS_SUPPORT
		select MTK_MT7663E_DOT11_N_SUPPORT
		select MTK_MT7663E_DOT11_VHT_AC
		select MTK_MT7663E_HDR_TRANS_TX_SUPPORT
		select MTK_MT7663E_HDR_TRANS_RX_SUPPORT
endif
endif

endif #MTK_MT7663E_WIFI_DRIVER#
endif #PACKAGE_kmod-mt7663e#
```
